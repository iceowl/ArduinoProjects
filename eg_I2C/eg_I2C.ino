/******************************************************************************
  MCP4725 Example Waveform Sketch
  Joel Bartlett
  SparkFun Electronics
  Sept. 11, 2014
  https://github.com/sparkfun/MCP4725_Breakout

  This sketch takes data from a lookup table to provide
  waveforms to be generated by the MCP4725 DAC.

  Development environment specifics:
  Arduino 1.0+
  Hardware Version V14

  This code is beerware; if you see me (or any other SparkFun employee) at the local,
  and you've found our code helpful, please buy us a round!

  Distributed as-is; no warranty is given.

  This code builds off the sketch written by Mark VandeWettering, which can be found here:
  http://brainwagon.org/2011/02/24/arduino-mcp4725-breakout-board/
*/

#include <Wire.h>//Include the Wire library to talk I2C

//This is the I2C Address of the MCP4725, by default (A0 pulled to GND).
//Please note that this breakout is for the MCP4725A0.
#define MCP4725_ADDR 0x60
#define MAXWAVEFORM   4
#define MAXSAMPLESNUM 120
#define WAVE0   0
#define WAVE1   1
#define WAVE2   2
#define WAVE3   3
#define PWMTIMER2_B   3
#define PWMTIMER2_A   11

//For devices with A0 pulled HIGH, use 0x61

//Sinewave Tables were generated using this calculator:
//http://www.daycounter.com/Calculators/Sine-Generator-Calculator.phtml


int lookup = 0;//varaible for navigating through the tables
/*
int sintab2[64] =
{
  1024, 1124, 1224, 1321, 1416, 1507, 1593, 1674,
  1748, 1816, 1875, 1927, 1970, 2004, 2028, 2043,
  2048, 2043, 2028, 2004, 1970, 1927, 1875, 1816,
  1748, 1674, 1593, 1507, 1416, 1321, 1224, 1124,
  1024, 924, 824, 727, 632, 541, 455, 374,
  300, 232, 173, 121, 78, 44, 20, 5,
  0, 5, 20, 44, 78, 121, 173, 232,
  300, 374, 455, 541, 632, 727, 824, 924
};
*/
static int waveformsTable[MAXWAVEFORM][MAXSAMPLESNUM];
int i = 0;

void setup()
{
  Wire.begin();

  // Set A2 and A3 as Outputs to make them our GND and Vcc,
  //which will power the MCP4725
  pinMode(A2, OUTPUT);
  pinMode(A3, OUTPUT);

  digitalWrite(A2, LOW);//Set A2 as GND
  digitalWrite(A3, HIGH);//Set A3 as Vcc

  for (int i = 0; i < MAXSAMPLESNUM; i++) {
    waveformsTable[WAVE0][i] = 127.0 * (1.0 + sin ((float)i * 3.14159 / 60.0)); //sine
    waveformsTable[WAVE1][i] = 3.0 * (float)(i % 30);                           //sawtooth
    waveformsTable[WAVE2][i] = 3.0 * (60.0 - (float)(abs(( i % 120 ) - 60)));   // triangle
    if( i%2) waveformsTable[WAVE3][i] = 127;  // square
    else waveformsTable[WAVE3][i] = 0;
  }

  Wire.beginTransmission(MCP4725_ADDR);
  Wire.write(0); // set Fast mode?
  Wire.endTransmission();
}
//---------------------------------------------------
void loop()
{
 // delayMicroseconds(50);
  Wire.beginTransmission(MCP4725_ADDR);
  Wire.write(64);                     // cmd to update the DAC
 
  //Wire.write(sintab2[lookup] >> 4);        // the 8 most significant bits...
  //Wire.write((sintab2[lookup] & 15) << 4); // the 4 least significant bits...
  Wire.write(waveformsTable[WAVE1][lookup]) >> 4;
  Wire.write(waveformsTable[WAVE1][lookup++] & 15) << 4;
  Wire.endTransmission();
 // lookup = (lookup + 1) & (MAXSAMPLESNUM - 1);
 if(lookup >= MAXSAMPLESNUM) lookup = 0;
}
